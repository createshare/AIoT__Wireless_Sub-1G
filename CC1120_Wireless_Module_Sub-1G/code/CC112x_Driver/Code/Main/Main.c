/*=*=*=*=*=*=*=*=*=*=*=*=*=*=*=*=*=*=*=*=*=*=*=*=*=*=*=*=*=*=*=*=*=*=*=
◆项目-Project:			CC112x 无线模块
◆设计者-Author:		BlueS
◆处理器-Processor: 		MSP430f6638  CC1120      
◆编译器-Complier: 		IAR for MSP430 v5.50.2  or higher
◆仿真器-IDE: 			IAR for MSP430 v5.50.2  or higher
◆版本-Version: 			V1.0
◆日期-Date: 			2013-05-20
①②③④⑤⑥⑦⑧⑨⑩
~~~~~~~~~~~~~~~~~~~~~~~~~~~~~~~~~~~~~~~~~~~~~~~~~~~~~~~~~~~~~~
* 文件名-FileName:			 Main.c
* 附属文件-Dependencies:  	 System.h;
* 文件描述-File Description:	 ( 源程序-Source File)
	■01)  晶振:XT1: 外接32.768 KHz; 
	■02)  XT2 外接4MHz 作为SMCLK时钟源 
	■03)  系统频率MCLK =12M  (DCO  FLL倍频到12MHz)   
	■04)  SMCLK = XT2 = 4M  
	■05)  ACLK = XT1 =   32.768 KHz
	■06)	
~~~~~~~~~~~~~~~~~~~~~~~~~~~~~~~~~~~~~~~~~~~~~~~~~~~~~~~~~~~~~~
* 注意事项-Attention : 	
	▲01)当 DCO  FLL倍频到12MHz 作为MCLK时钟源(系统频率)
	        故 __delay_cycles(12000000); //(1/12M)*12000000=1s
	▲02) 当 DCO  FLL倍频到20MHz(实际>20M) 作为MCLK时钟源(系统频率)
	        故 __delay_cycles(20000000); //约980ms ≈ (1/20M)*20000000=1s(系统频率>20M)   
	▲03)	  ▲04)    ▲05)      ▲06)	
~~~~~~~~~~~~~~~~~~~~~~~~~~~~~~~~~~~~~~~~~~~~~~~~~~~~~~~~~~~~~~  
* 修改记录-Change History:   
	作者   时间        版本  内容描述
	Author 	 Date		   Rev      Comment
	-------------------------------------------------------------------------------
	BlueS	2013-05-20	 1.0	   
			xxxx-xx-xx	  x.x	   
			xxxx-xx-xx	  x.x				
~~~~~~~~~~~~~~~~~~~~~~~~~~~~~~~~~~~~~~~~~~~~~~~~~~~~~~~~~~~~~~	
* 公司-Company: 			CS-EMLAB  Co. , Ltd.
* 软件许可协议-Software License Agreement:
	Copyright (C) 2012-2020 	CS-EMLAB  Co. , Ltd.	All rights reserved.	

*=*=*=*=*=*=*=*=*=*=*=*=*=*=*=*=*=*=*=*=*=*=*=*=*=*=*=*=*=*=*=*=*=*=*=*/


#include "System.h"	 //"系统" 常用功能函数集-头文件

#include "cc112x_easy_link.h"  //"CC112x 低功耗无线射频收发器"-驱动程序(外部资源)-头文件


/****************************************************************************
*函数名-Function:	void main(void)
*描述- Description:		主函数
*输入参数-Input:	None
*输出参数-output:	None
*注意事项-Note：	▲01)    ▲02)    ▲03)    ▲04)  
*****************************************************************************/
void main(void)
{

	mClose_WDT;   // 关闭看门狗	 
	mDisable_GIE; //关闭中断

	System_Initial();  //  系统初使化 :单片机内部资源+外部基本资源的初使化

				
	Initial_CC112x();  //初始化设置:  "CC112x 低功耗无线射频收发器"

	mEnable_GIE;  // 开启总中断//good 放在初始化最后面

	WaitingDelayMs(1000);


/////////////////////////////////////////////////////////////////////////////

while(1)
{
////////////////////////////////////////////////////////////////////////////
//==**系统每10ms"循环"执行一次程序**===================//
//	System_GetLoopClockTick(); //每次"死等"延时10ms后，系统"循环"执行一次程序


////////////////////////////////////////////////////////////////////////////
//==**工作指示灯(每250ms闪烁一次)**====================//
	System_Working_Led();  //单片机正常工作指示灯: 250ms闪烁一次//也说明晶振和系统频率都正确


////////////////////////////////////////////////////////////////////////////
//==**处理接收部分"CC112x 低功耗无线射频收发器"**=====//
	Deal_RX_CC112x();  //处理接收部分"CC112x 低功耗无线射频收发器"


////////////////////////////////////////////////////////////////////////////
//==**处理发送部分"CC112x 低功耗无线射频收发器"**=====//
	if(Detect_Key_2()) 
	{
		mTurn_LED_RED;

		//更新数据包计数器// Update packet counter
		CC112x_TX_PacketCnt++;
		Sent_DataToArray(CC112x_TxBuf,(unsigned char)CC112x_TX_PacketCnt,16);
		CC112x_TxBuf[0]=15;

			//CC112x发送数据(字符串)-- "CC112x 低功耗无线射频收发器"
		TX_String_CC112x(CC112x_TxBuf,16); 
	}


	if(Detect_Key_1()) 
	{
		mTurn_LED_YELLOW;
		mNop;
	}


}
}




